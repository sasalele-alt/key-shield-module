#include "key.dtsi"

/ {
    chosen {
        zmk,kscan = &kscan0;
    };

    kscan0: kscan {
        compatible = "zmk,kscan-gpio-matrix";
        diode-direction = "row2col";
        wakeup-source;

        col-gpios
            = <&pro_micro 0 (GPIO_ACTIVE_HIGH | GPIO_PULL_DOWN)>   
            , <&pro_micro 14 (GPIO_ACTIVE_HIGH | GPIO_PULL_DOWN)>  
            , <&pro_micro 15 (GPIO_ACTIVE_HIGH | GPIO_PULL_DOWN)>  
            , <&pro_micro 18 (GPIO_ACTIVE_HIGH | GPIO_PULL_DOWN)>  
            , <&pro_micro 21 (GPIO_ACTIVE_HIGH | GPIO_PULL_DOWN)>  
            , <&pro_micro 20 (GPIO_ACTIVE_HIGH | GPIO_PULL_DOWN)>  
            ;

        row-gpios
            = <&pro_micro 1 GPIO_ACTIVE_HIGH>   
            , <&pro_micro 19 GPIO_ACTIVE_HIGH>  
            , <&pro_micro 16 GPIO_ACTIVE_HIGH>  
            , <&pro_micro 10 GPIO_ACTIVE_HIGH>  
            ;
    };

    // Добавьте этот кусочек в самый низ файла key_right.overlay
    &default_transform {
        col-offset = <6>;
    };
};
