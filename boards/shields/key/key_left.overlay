#include "key.dtsi"

&kscan0 {
    col-gpios
    col-gpios
        = <&pro_micro 7 (GPIO_ACTIVE_HIGH | GPIO_PULL_DOWN)>   // столбец 0
        , <&pro_micro 6 (GPIO_ACTIVE_HIGH | GPIO_PULL_DOWN)>   // столбец 1
        , <&pro_micro 5 (GPIO_ACTIVE_HIGH | GPIO_PULL_DOWN)>   // столбец 2
        , <&pro_micro 3 (GPIO_ACTIVE_HIGH | GPIO_PULL_DOWN)>   // столбец 3
        , <&pro_micro 0 (GPIO_ACTIVE_HIGH | GPIO_PULL_DOWN)>   // столбец 4
        , <&pro_micro 2 (GPIO_ACTIVE_HIGH | GPIO_PULL_DOWN)>   // столбец 5
        ;

    row-gpios
        = <&pro_micro 1 GPIO_ACTIVE_HIGH>  // строка 0
        , <&pro_micro 4 GPIO_ACTIVE_HIGH>  // строка 1
        , <&pro_micro 8 GPIO_ACTIVE_HIGH>  // строка 2
        , <&pro_micro 9 GPIO_ACTIVE_HIGH> // строка 3
        ;
};
