#include "key.dtsi"

/ {
    chosen {
        zmk,kscan = &mock_kscan;
    };

    mock_kscan: kscan_mock {
        compatible = "zmk,kscan-mock";
        columns = <0>;
        rows = <0>;
        events = <>;
    };
};
