## boards/shields/key/Kconfig.defconfig
```kconfig
if SHIELD_KEY_DONGLE

config ZMK_KEYBOARD_NAME
    default "ZMK Keyboard"

config ZMK_SPLIT_ROLE_CENTRAL
    default y

endif

if SHIELD_KEY_LEFT || SHIELD_KEY_RIGHT

config ZMK_SPLIT_ROLE_CENTRAL
    default n

endif

if SHIELD_KEY_RIGHT

config ZMK_KEYBOARD_NAME
    default "ZMK Keyboard"

# Системное переключение правой половины на уровне ядра
config ZMK_SPLIT_ROLE_PERIPHERAL_RIGHT
    default y

endif
```

## boards/shields/key/Kconfig.shield
```kconfig
config SHIELD_KEY_DONGLE
    def_bool $(shields_list_contains,key_dongle)
    select ZMK_SPLIT_ROLE_CENTRAL

config SHIELD_KEY_LEFT
    def_bool $(shields_list_contains,key_left)

config SHIELD_KEY_RIGHT
    def_bool $(shields_list_contains,key_right)
    # select ZMK_SPLIT_ROLE_PERIPHERAL_RIGHT
```
